## source/DebugESP/sdkconfig.defaults
```kconfig
CONFIG_ARDUINO_RUNNING_CORE=1
CONFIG_ARDUINO_EVENT_RUNNING_CORE=1
CONFIG_ARDUINO_SERIAL_ENABLED=y
CONFIG_USB_CDC_ENABLED=y
CONFIG_ARDUINO_USB_MODE=1
CONFIG_ARDUINO_USB_CDC_ON_BOOT=y
CONFIG_ARDUINO_USB_MSC_ON_BOOT=n
CONFIG_FREERTOS_HZ=1000
CONFIG_ESP32S3_DEFAULT_CPU_FREQ_240=y
CONFIG_IDF_TARGET_ESP32S3=y
```
